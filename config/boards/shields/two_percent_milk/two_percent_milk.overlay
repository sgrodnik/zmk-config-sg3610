/*
 * Copyright (c) 2022 The ZMK Contributors
 *
 * SPDX-License-Identifier: MIT
 */

#include "pmw3610.dtsi"

/ {
    chosen {
        zmk,kscan = &kscan0;
    };

    kscan0: kscan {
        compatible = "zmk,kscan-gpio-direct";
        wakeup-source;

        input-gpios
            = <&gpio0 17 (GPIO_ACTIVE_LOW | GPIO_PULL_UP)>
            , <&gpio0  8 (GPIO_ACTIVE_LOW | GPIO_PULL_UP)>
            ;

    };

};